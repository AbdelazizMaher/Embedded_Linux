## Embedded_Linux/08-BuildRoot/SayHELLO/Config.in
```kconfig
config BR2_PACKAGE_SAY-HELLO
        bool "say-hello-app"
        help
          A package that display "hello from the buildroot".
```

## Embedded_Linux/09_Yocto/Bitbake/mylayer/conf/layer.conf
```bitbake
BBPATH .= ":${LAYERDIR}"
BBFILES += "${LAYERDIR}/*.bb"
BBFILE_COLLECTIONS += "mylayer"
BBFILE_PATTERN_mylayer := "^${LAYERDIR_RE}/"
LAYERSERIES_CORENAMES = "hello_world_example"
LAYERSERIES_COMPAT_mylayer = "hello_world_example"
```

## Embedded_Linux/09_Yocto/InitApp_Task/meta-Mylayer/conf/layer.conf
```bitbake
# We have a conf and classes directory, add to BBPATH
BBPATH .= ":${LAYERDIR}"

# We have recipes-* directories, add to BBFILES
BBFILES += "${LAYERDIR}/recipes-*/*/*.bb \
            ${LAYERDIR}/recipes-*/*/*.bbappend"

BBFILE_COLLECTIONS += "meta-Mylayer"
BBFILE_PATTERN_meta-Mylayer = "^${LAYERDIR}/"
BBFILE_PRIORITY_meta-Mylayer = "6"

LAYERDEPENDS_meta-Mylayer = "core"
LAYERSERIES_COMPAT_meta-Mylayer = "dunfell"
```

## Embedded_Linux/09_Yocto/InitApp_Task/meta-bbappendLayer/conf/layer.conf
```bitbake
# We have a conf and classes directory, add to BBPATH
BBPATH .= ":${LAYERDIR}"

# We have recipes-* directories, add to BBFILES
BBFILES += "${LAYERDIR}/recipes-*/*/*.bb \
            ${LAYERDIR}/recipes-*/*/*.bbappend"

BBFILE_COLLECTIONS += "meta-bbapendLayer"
BBFILE_PATTERN_meta-bbapendLayer = "^${LAYERDIR}/"
BBFILE_PRIORITY_meta-bbapendLayer = "6"

LAYERDEPENDS_meta-bbapendLayer = "core"
LAYERSERIES_COMPAT_meta-bbapendLayer = "dunfell"
```
